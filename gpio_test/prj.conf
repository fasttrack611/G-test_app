## CMakeLists.txt
```
cmake_minimum_required(VERSION 3.20)
find_package(Zephyr REQUIRED HINTS $ENV{ZEPHYR_BASE})
project(gpio_test)

# Main application sources
target_sources(app PRIVATE
    src/main.c
    src/gpio_test_utils.c
)

# Add test sources directly
if (CONFIG_ZTEST)
    target_sources(app PRIVATE
        tests/test_gpio.c
    )
    
    # Manually set include directories
    target_include_directories(app PRIVATE
        ${CMAKE_CURRENT_SOURCE_DIR}/src
        ${ZEPHYR_BASE}/tests/ztest/include
    )
    
    # Link ztest library
    zephyr_link_libraries_ifdef(CONFIG_ZTEST ztest)
endif()
```

## prj.conf
```kconfig
CONFIG_GPIO=y
CONFIG_GPIO_EMUL=y
CONFIG_ZTEST=y
CONFIG_ZTEST_STACK_SIZE=2048
CONFIG_TEST_USERSPACE=n
CONFIG_MAIN_STACK_SIZE=2048
CONFIG_LOG=y
```

## qemu_x86.overlay
```dts
/ {
    gpio0: gpio-emul-0 {
        compatible = "zephyr,gpio-emul";
        label = "GPIO_0";
        gpio-controller;
        #gpio-cells = <2>;
        ngpios = <16>;
        status = "okay";
    };

    gpio1: gpio-emul-1 {
        compatible = "zephyr,gpio-emul";
        label = "GPIO_1";
        gpio-controller;
        #gpio-cells = <2>;
        ngpios = <16>;
        status = "okay";
    };
};
```

## src/main.c
```c
#include <zephyr/kernel.h>

int main(void) {
    printk("Hello from GPIO test!\n");
    return 0;
}
```

## src/gpio_test_utils.c
```c
#include <zephyr/drivers/gpio.h>
#include <zephyr/sys/__assert.h>

const struct device *get_gpio_device(const char *label)
{
    const struct device *dev = device_get_binding(label);
    __ASSERT(dev != NULL, "GPIO device not found");
    return dev;
}

int configure_gpio(const struct device *dev, gpio_pin_t pin, 
                   gpio_flags_t flags)
{
    return gpio_pin_configure(dev, pin, flags);
}

int set_gpio(const struct device *dev, gpio_pin_t pin, int value)
{
    return gpio_pin_set(dev, pin, value);
}

int get_gpio(const struct device *dev, gpio_pin_t pin)
{
    return gpio_pin_get(dev, pin);
}
```

## src/gpio_test_utils.h
```c
#ifndef GPIO_TEST_UTILS_H
#define GPIO_TEST_UTILS_H

#include <zephyr/drivers/gpio.h>

const struct device *get_gpio_device(const char *label);
int configure_gpio(const struct device *dev, gpio_pin_t pin, gpio_flags_t flags);
int set_gpio(const struct device *dev, gpio_pin_t pin, int value);
int get_gpio(const struct device *dev, gpio_pin_t pin);

#endif /* GPIO_TEST_UTILS_H */
```

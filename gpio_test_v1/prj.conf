## CMakeLists.txt
```
cmake_minimum_required(VERSION 3.20.0)
find_package(Zephyr REQUIRED HINTS $ENV{ZEPHYR_BASE})
project(gpio_test)

target_sources(app PRIVATE src/test_gpio.c src/gpio_test_utils.c)
```

## prj.conf
```kconfig
CONFIG_ZTEST=y
CONFIG_TEST=y
CONFIG_GPIO=y
CONFIG_GPIO_EMUL=y
CONFIG_MAIN_STACK_SIZE=2048
CONFIG_COVERAGE=y
CONFIG_COVERAGE_GCOV=y
CONFIG_COVERAGE=y
CONFIG_COVERAGE_DUMP=y
```

## src/gpio_test_utils.c
```c
// Include Zephyr's device model header.
// This provides access to core device structures and functions like device_get_binding().
#include <zephyr/device.h>

// Include the GPIO driver API definitions.
// Needed when working with GPIO devices retrieved via device_get_binding().
#include <zephyr/drivers/gpio.h>

/*
 * Function: get_gpio_device
 * -------------------------
 * Takes a string 'label' representing the device label defined in the devicetree
 * and returns a pointer to the corresponding 'device' structure.
 *
 * This device structure can then be used with GPIO API functions such as
 * gpio_pin_configure(), gpio_pin_set(), etc.
 *
 * Parameters:
 *  - label: Name of the GPIO device, e.g., "GPIOA" or "GPIO_0", as defined in devicetree.
 *
 * Returns:
 *  - Pointer to the device structure if the label is valid and the device is found.
 *  - NULL if no matching device was found.
 */
const struct device *get_gpio_device(const char *label) {
    return device_get_binding(label);
}
```

## src/gpio_test_utils.h
```c
#ifndef GPIO_TEST_UTILS_H
#define GPIO_TEST_UTILS_H

// Include the Zephyr device API header for working with struct device and device binding functions
#include <zephyr/device.h>

#ifdef __cplusplus
extern "C" {
#endif

/**
 * @brief Retrieve a GPIO device pointer using a device label.
 *
 * This utility function looks up a GPIO device from the Zephyr device tree
 * based on the string label provided. It wraps the DEVICE_DT_GET binding logic.
 *
 * Example usage:
 *   const struct device *gpio_dev = get_gpio_device("GPIO_0");
 *
 * @param label The devicetree label (e.g., "GPIO_0", "GPIOA", etc.)
 * @return const struct device* Pointer to device structure, or NULL if not found.
 */
const struct device *get_gpio_device(const char *label);

#ifdef __cplusplus
}
#endif

#endif // GPIO_TEST_UTILS_H
```

## src/test_gpio.c
```c
// Include Zephyr's unit testing framework
#include <zephyr/ztest.h>

// Include Zephyr's GPIO driver API
#include <zephyr/drivers/gpio.h>

// Include a custom utility header (assumed to contain get_gpio_device())
#include "gpio_test_utils.h"

// Label for the GPIO controller; should match what's defined in the board’s devicetree
#define GPIO_LABEL "GPIO_0"

// The GPIO pin number to test
#define TEST_PIN   2

// Global pointer to hold the GPIO device handle
static const struct device *gpio_dev;

// Test fixture setup function: runs before each test (if fixture is used)
static void gpio_setup(void *fixture)
{
    // Attempt to get the GPIO device handle
    gpio_dev = get_gpio_device(GPIO_LABEL);

    // Assert that the device was successfully retrieved
    zassert_not_null(gpio_dev, "Failed to get GPIO device");
}

// Register a test suite named 'gpio_suite'
// Arguments: suite name, setup fixture, before/after each test, before/after entire suite
ZTEST_SUITE(gpio_suite, NULL, gpio_setup, NULL, NULL, NULL);

// Test case: Configure the test pin as OUTPUT
ZTEST(gpio_suite, test_pin_configure_output)
{
    int ret = gpio_pin_configure(gpio_dev, TEST_PIN, GPIO_OUTPUT);
    zassert_equal(ret, 0, "Failed to configure pin as output");
}

// Test case: Configure the test pin as INPUT
ZTEST(gpio_suite, test_pin_configure_input)
{
    int ret = gpio_pin_configure(gpio_dev, TEST_PIN, GPIO_INPUT);
    zassert_equal(ret, 0, "Failed to configure pin as input");
}

// Test case: Set pin HIGH, then LOW
ZTEST(gpio_suite, test_pin_set)
{
    int ret = gpio_pin_set(gpio_dev, TEST_PIN, 1); // Set high
    zassert_equal(ret, 0, "Failed to set pin high");

    ret = gpio_pin_set(gpio_dev, TEST_PIN, 0); // Set low
    zassert_equal(ret, 0, "Failed to set pin low");
}

// Simulated state used when actual GPIO reads aren’t available
static int simulated_pin_state = 0;

// Test case: Emulate pin set/get using a simulated variable
ZTEST(gpio_suite, test_pin_set_get_simulated)
{
    int ret;

    ret = gpio_pin_set(gpio_dev, TEST_PIN, 1);
    zassert_equal(ret, 0, "Failed to set pin high");
    simulated_pin_state = 1;

    int val = simulated_pin_state;
    zassert_equal(val, 1, "Pin value should be 1");

    ret = gpio_pin_set(gpio_dev, TEST_PIN, 0);
    zassert_equal(ret, 0, "Failed to set pin low");
    simulated_pin_state = 0;

    val = simulated_pin_state;
    zassert_equal(val, 0, "Pin value should be 0");
}

// Test case: Use Zephyr's gpio_pin_get() to read pin value after setting it
ZTEST(gpio_suite, test_pin_set_get)
{
    gpio_pin_set(gpio_dev, TEST_PIN, 0);
    int val = gpio_pin_get(gpio_dev, TEST_PIN);
    zassert_equal(val, 0, "Pin value should be 0");

    gpio_pin_set(gpio_dev, TEST_PIN, 1);
    val = gpio_pin_get(gpio_dev, TEST_PIN);
    zassert_equal(val, 1, "Pin value should be 1");
}
```
